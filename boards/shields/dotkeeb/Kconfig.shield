## boards/shields/dotkeeb/Kconfig.shield
```kconfig
config SHIELD_DOTKEEB_DONGLE
    def_bool $(shields_list_contains,dotkeeb_dongle)

config SHIELD_DOTKEEB_LEFT
    def_bool $(shields_list_contains,dotkeeb_left)

config SHIELD_DOTKEEB_RIGHT
    def_bool $(shields_list_contains,dotkeeb_right)
```
